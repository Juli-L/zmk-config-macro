#include <dt-bindings/zmk/matrix_transform.h>

/ {
    chosen {
        zmk,kscan = &default_kscan;
        zmk,matrix_transform = &default_transform;
    };

    default_kscan: kscan {
        compatible = "zmk,kscan-gpio-matrix";
        label = "default_kscan";
        diode-direction = "col2row";

        row-gpios = <&xiao_d 4 (GPIO_ACTIVE_HIGH| GPIO_PULL_UP)>,
                    <&xiao_d 5 (GPIO_ACTIVE_HIGH| GPIO_PULL_UP)>,
                    <&xiao_d 6 (GPIO_ACTIVE_HIGH| GPIO_PULL_UP)>;
    
        col-gpios = <&xiao_d 0 (GPIO_ACTIVE_HIGH)>,
                    <&xiao_d 1 (GPIO_ACTIVE_HIGH)>,
                    <&xiao_d 2 (GPIO_ACTIVE_HIGH| GPIO_PULL_DOWN)>,
                    <&xiao_d 3 (GPIO_ACTIVE_HIGH| GPIO_PULL_DOWN)>;
              
    };


    
