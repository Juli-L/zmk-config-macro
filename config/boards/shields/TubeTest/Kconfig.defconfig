## config/boards/shields/TubeTest/Kconfig.defconfig
```kconfig
if SHIELD_TUBETEST
            
config ZMK_KEYBOARD_NAME
    default "TubeTest"
    

endif
CONFIG_ZMK_USB_LOGGING=y
```

## config/boards/shields/TubeTest/Kconfig.shield
```kconfig
config SHIELD_TUBETEST
    def_bool $(shields_list_contains, TubeTest)
    # Turn on logging, and set ZMK logging to debug output
    CONFIG_ZMK_USB_LOGGING=y
```
